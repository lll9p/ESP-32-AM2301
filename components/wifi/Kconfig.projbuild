## components/wifi/Kconfig.projbuild
```kconfig
menu "WIFI Connection Configuration"

    config CONNECT_WIFI
        bool "connect using WiFi interface"
        default y
        help
            Protocol examples can use Wi-Fi and/or Ethernet to connect to the network.
            Choose this option to connect with WiFi

    if CONNECT_WIFI
        config WIFI_SSID
            string "WiFi SSID"
            default "myssid"
            help
                SSID (network name) for the example to connect to.

        config WIFI_PASSWORD
            string "WiFi Password"
            default "mypassword"
            help
                WiFi password (WPA or WPA2) for the example to use.
                Can be left blank if the network has no security set.

        choice WIFI_SCAN_METHOD
            prompt "WiFi Scan Method"
            default WIFI_SCAN_METHOD_FAST
            help
                WiFi scan method:

                If "Fast" is selected, scan will end after find SSID match AP.

                If "All Channel" is selected, scan will end after scan all the channel.

            config WIFI_SCAN_METHOD_FAST
                bool "Fast"
            config WIFI_SCAN_METHOD_ALL_CHANNEL
                bool "All Channel"
        endchoice

        menu "WiFi Scan threshold"
            config WIFI_SCAN_RSSI_THRESHOLD
                int "WiFi minimum rssi"
                range -127 0

                default -127
                help
                    The minimum rssi to accept in the scan mode.

            choice WIFI_SCAN_AUTH_MODE_THRESHOLD
                prompt "WiFi Scan auth mode threshold"
                default WIFI_AUTH_OPEN
                help
                    The weakest authmode to accept in the scan mode.

                config WIFI_AUTH_OPEN
                    bool "OPEN"
                config WIFI_AUTH_WEP
                    bool "WEP"
                config WIFI_AUTH_WPA_PSK
                    bool "WPA PSK"
                config WIFI_AUTH_WPA2_PSK
                    bool "WPA2 PSK"
                config WIFI_AUTH_WPA_WPA2_PSK
                    bool "WPA WPA2 PSK"
                config WIFI_AUTH_WPA2_ENTERPRISE
                    bool "WPA2 ENTERPRISE"
                config WIFI_AUTH_WPA3_PSK
                    bool "WPA3 PSK"
                config WIFI_AUTH_WPA2_WPA3_PSK
                    bool "WPA2 WPA3 PSK"
                config WIFI_AUTH_WAPI_PSK
                    bool "WAPI PSK"
            endchoice
        endmenu

        choice WIFI_CONNECT_AP_SORT_METHOD
            prompt "WiFi Connect AP Sort Method"
            default WIFI_CONNECT_AP_BY_SIGNAL
            help
                WiFi connect AP sort method:

                If "Signal" is selected, Sort matched APs in scan list by RSSI.

                If "Security" is selected, Sort matched APs in scan list by security mode.

            config WIFI_CONNECT_AP_BY_SIGNAL
                bool "Signal"
            config WIFI_CONNECT_AP_BY_SECURITY
                bool "Security"
        endchoice
    endif

    config CONNECT_IPV6
        bool "Obtain IPv6 address"
        default y
        depends on CONNECT_WIFI
        select LWIP_IPV6
        help
            By default, examples will wait until IPv4 and IPv6 local link addresses are obtained.
            Disable this option if the network does not support IPv6.
            Choose the preferred IPv6 address type if the connection code should wait until other than
            the local link address gets assigned.
            Consider enabling IPv6 stateless address autoconfiguration (SLAAC) in the LWIP component.

    if CONNECT_IPV6
        choice CONNECT_PREFERRED_IPV6
            prompt "Preferred IPv6 Type"
            default CONNECT_IPV6_PREF_LOCAL_LINK
            help
                Select which kind of IPv6 address the connect logic waits for.

            config CONNECT_IPV6_PREF_LOCAL_LINK
                bool "Local Link Address"
                help
                    Blocks until Local link address assigned.

            config CONNECT_IPV6_PREF_GLOBAL
                bool "Global Address"
                help
                    Blocks until Global address assigned.

            config CONNECT_IPV6_PREF_SITE_LOCAL
                bool "Site Local Address"
                help
                    Blocks until Site link address assigned.

            config CONNECT_IPV6_PREF_UNIQUE_LOCAL
                bool "Unique Local Link Address"
                help
                    Blocks until Unique local address assigned.

        endchoice

    endif


endmenu
```
